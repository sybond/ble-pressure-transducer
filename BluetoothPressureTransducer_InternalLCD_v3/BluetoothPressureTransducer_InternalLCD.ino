/*

 Bluetooth Pressure Transducer
 Copyright (c) 2023 Bondan Sumbodo <sybond@gmail.com>

 FOR WEMOS LOLIN32

 History:
 2023/03/23 - First version : playing with BLE characteristic
 2023/03/24 - Adding Pressure BLECharacteristic, Battery Level BLECharacteristic
            - Fix pressure data format encoding
 2023/03/30 - Rewrite for WEMOS LOLIN32 board
            - Adding logo
            - New calculation of pressure, since in LOLIN32 they have 5V input for sensor
 2023/05/01 - Allow to display pressure without waiting BLE connected
 2024/02/23 - Saving last minVoltage into NVS
 2024/02/24 - Revisit pressure calculation
            - Adding minVoltage, maxVoltage, maxMilibar to NVS
            - Adding characteristic for future use, currently to reset NVS stored value to default value
 2024/02/28 - Adding new calibrated point for ADC known value for 9 Bar pressure
 2024/03/08 - Rework on configuration part. Removing `minVoltage` and `maxVoltage`.
            - Adding serial com settings
            - All pressure calculation now should be configurable using `map(analogValue,minADC,maxADC,0,maxMilibar)`.

*/
#include <BLEDevice.h>
#include <BLEServer.h>
#include <BLEUtils.h>
#include <BLE2902.h>

#include <Adafruit_GFX.h>
#include <Adafruit_SSD1306.h>

#include <Preferences.h>

BLEServer* pServer = NULL;
BLECharacteristic* pCharPressure = NULL;
BLECharacteristic* pCharZeroPressure = NULL;
BLECharacteristic* pCharPressureConfig = NULL;
BLECharacteristic* pCharBatt = NULL;
BLECharacteristic* pCharLog = NULL;
BLECharacteristic* pCharMFC = NULL;


#define SCREEN_WIDTH 128     // OLED display width, in pixels
#define SCREEN_HEIGHT 64     // OLED display height, in pixels
#define OLED_RESET -1        // Reset pin # (or -1 if sharing Arduino reset pin)
#define SCREEN_ADDRESS 0x3C  ///< See datasheet for Address; 0x3D for 128x64, 0x3C for 128x32
Adafruit_SSD1306 display(SCREEN_WIDTH, SCREEN_HEIGHT, &Wire, OLED_RESET);

bool deviceConnected = false;
bool oldDeviceConnected = false;
bool printLog = false;
int BattLevel = 100;
int32_t value = 0xB6032823;
int32_t value2 = 0x00;
int barPotentio = 0;
int counter = 0;

float minVoltage = 0.5;
float maxVoltage = 4.5;
float currVoltage = 0;
long maxMilibar = 16000;  //default 16bar

int Potentio = 0;
float currBar = 0.0;

uint8_t pressData[4] = { 0x03, 0xb6, 0x0, 0x0 };
char text[200];
char dev_name[20];
Preferences configNVS;


#define fw_ver "v2.6 WL"

static unsigned char logosybond_led_bits[] = {
  0x00, 0x00, 0x00, 0x00, 0x00, 0x00, 0xe0, 0x01, 0x00, 0x00, 0x00, 0x70,
  0x00, 0x00, 0x00, 0x00, 0x00, 0x00, 0x00, 0xe0, 0x01, 0x00, 0x00, 0x00,
  0x70, 0x00, 0xc0, 0xff, 0xff, 0x07, 0x00, 0x00, 0xe0, 0x01, 0x00, 0x00,
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  0x07, 0x00, 0x00, 0x00, 0x00, 0x00, 0x00, 0x00, 0x00, 0x00
};


class MyServerCallbacks : public BLEServerCallbacks {
};

class MyPressChCallbacks : public BLECharacteristicCallbacks {
};

class MyConfigChCallbacks : public BLECharacteristicCallbacks {
};


void prepDisplay() {
  Wire.begin(5, 4);
  // SSD1306_SWITCHCAPVCC = generate display voltage from 3.3V internally
  if (!display.begin(SSD1306_SWITCHCAPVCC, SCREEN_ADDRESS)) {
    Serial.println(F("SSD1306 allocation failed"));
    for (;;)
      ;  // Don't proceed, loop forever
  }

  // Show initial display buffer contents on the screen --
  // the library initializes this with an Adafruit splash screen.
  display.clearDisplay();
  display.setTextSize(1);               // Normal 1:1 pixel scale
  display.setTextColor(SSD1306_WHITE);  // Draw white text
  display.setCursor(0, 0);              // Start at top-left corner
  display.cp437(true);                  // Use full 256 char 'Code Page 437' font
  display.display();
  delay(2000);  // Pause for 2 seconds
}

void setup() {
 // ----- stripped -------
}

float getSensorvalue(int analoge) {
  int adc_value_final = 0;
  int adc_samples = 64;
  int min_adc = (minVoltage * 4095) / maxVoltage;
  for (int i = 0; i < adc_samples; i++) {
    adc_value_final += analogRead(analoge);
  }
  adc_value_final /= adc_samples;
  if (adc_value_final < min_adc) { adc_value_final = min_adc; }
  currVoltage = (adc_value_final * 4.5) / 4095.0;
  float bar = map(adc_value_final, min_adc, 4095, 0, maxMilibar * 10);
  if (printLog) {
    Serial.printf("Analog:%d, Vol:%.2fV, miliBar:%.2f\n", adc_value_final, currVoltage, bar / 10);
  }
  delay(100);
  return bar / 10;
}

//--------- the main loop -------
void loop() {
// ------ stripped --------------
}
