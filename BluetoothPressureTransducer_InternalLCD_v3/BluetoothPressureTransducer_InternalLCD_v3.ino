/*

 Bluetooth Pressure Transducer
 Copyright (c) 2023 Bondan Sumbodo <sybond@gmail.com>

 FOR WEMOS LOLIN32

 History:
 2023/03/23 - First version : playing with BLE characteristic
 2023/03/24 - Adding Pressure BLECharacteristic, Battery Level BLECharacteristic
            - Fix pressure data format encoding
 2023/03/30 - Rewrite for WEMOS LOLIN32 board
            - Adding logo
            - New calculation of pressure, since in LOLIN32 they have 5V input for sensor
 2023/05/01 - Allow to display pressure without waiting BLE connected

*/
#include <BLEDevice.h>
#include <BLEServer.h>
#include <BLEUtils.h>
#include <BLE2902.h>

#include <Adafruit_GFX.h>
#include <Adafruit_SSD1306.h>

BLEServer* pServer = NULL;
BLECharacteristic* pCharPressure = NULL;
BLECharacteristic* pCharZeroPressure = NULL;
BLECharacteristic* pCharBatt = NULL;
BLECharacteristic* pCharLog = NULL;
BLECharacteristic* pCharMFC = NULL;


#define SCREEN_WIDTH 128     // OLED display width, in pixels
#define SCREEN_HEIGHT 64     // OLED display height, in pixels
#define OLED_RESET -1        // Reset pin # (or -1 if sharing Arduino reset pin)
#define SCREEN_ADDRESS 0x3C  ///< See datasheet for Address; 0x3D for 128x64, 0x3C for 128x32
Adafruit_SSD1306 display(SCREEN_WIDTH, SCREEN_HEIGHT, &Wire, OLED_RESET);

bool deviceConnected = false;
bool oldDeviceConnected = false;
int BattLevel = 100;
int counter = 0;

float setZeroVol = 0.47;
float voltage = 0;

char text[200];
char dev_name[20];

class MyServerCallbacks : public BLEServerCallbacks {
  void onConnect(BLEServer* pServer) {
    deviceConnected = true;
  };
  void onDisconnect(BLEServer* pServer) {
    deviceConnected = false;
  }
};

class MyPressChCallbacks : public BLECharacteristicCallbacks {
  void onWrite(BLECharacteristic* pCharacteristic) {

    setZeroVol = voltage;
    Serial.printf("Set sero vol to %.2f\n", voltage);
    // std::string rxValue = pCharacteristic->getValue();
    // if (rxValue.length() > 0) {
    //   Serial.print("Received Value: ");
    //   for (int i = 0; i < rxValue.length(); i++)
    //     Serial.print(rxValue[i], HEX);
    //   Serial.println();
    // }
  }
};


static unsigned char logosybond_led_bits[] = {
  0x00, 0x00, 0x00, 0x00, 0x00, 0x00, 0xe0, 0x01, 0x00, 0x00, 0x00, 0x70,
  0x00, 0x00, 0x00, 0x00, 0x00, 0x00, 0x00, 0xe0, 0x01, 0x00, 0x00, 0x00,
  0x70, 0x00, 0xc0, 0xff, 0xff, 0x07, 0x00, 0x00, 0xe0, 0x01, 0x00, 0x00,
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  0x07, 0x00, 0x00, 0x00, 0x00, 0x00, 0x00, 0x00, 0x00, 0x00
};

void prepDisplay() {
  Wire.begin(5, 4);
  // SSD1306_SWITCHCAPVCC = generate display voltage from 3.3V internally
  if (!display.begin(SSD1306_SWITCHCAPVCC, SCREEN_ADDRESS)) {
    Serial.println(F("SSD1306 allocation failed"));
    for (;;)
      ;  // Don't proceed, loop forever
  }

  // Show initial display buffer contents on the screen --
  // the library initializes this with an Adafruit splash screen.
  display.clearDisplay();
  display.setTextSize(1);               // Normal 1:1 pixel scale
  display.setTextColor(SSD1306_WHITE);  // Draw white text
  display.setCursor(0, 0);              // Start at top-left corner
  display.cp437(true);                  // Use full 256 char 'Code Page 437' font
  display.display();
  delay(2000);  // Pause for 2 seconds
}

void setup() {
}

int Potentio = 0;
float currBar = 0.0;

void loop() {
}

float getSensorvalue(int analoge) {
  int adc_value_final = 0;
  int adc_samples = 64;
  for (int i = 0; i < adc_samples; i++) {
    adc_value_final += analogRead(analoge);
  }
  adc_value_final /= adc_samples;
  int sensorVal = adc_value_final;
  voltage = (sensorVal * 4.5) / 4095.0;
  float zeroVol = voltage - setZeroVol;
  if (zeroVol < 0) {
    zeroVol = 0;
  }
  float psiVal = ((zeroVol)*200) / (4.5 - setZeroVol);  //conversion equation to convert analog reading to psi
  float pressure_bar = ((zeroVol)*16000) / (4.5 - setZeroVol);  // in milibar
  Serial.printf("Analog:%d, Vol:%.2fV, psi:%.2f, miliBar:%.2f\n", sensorVal, voltage, psiVal, pressure_bar);
  delay(100);
  return pressure_bar;
}
